## defconfig
```kconfig
BR2_x86_64=y
BR2_TOOLCHAIN_BUILDROOT_MUSL=y
BR2_TARGET_GENERIC_HOSTNAME="owo"
BR2_TARGET_GENERIC_ISSUE="Welcome to owOS"
BR2_ROOTFS_OVERLAY="../src"
BR2_LINUX_KERNEL=y
BR2_LINUX_KERNEL_DEFCONFIG="x86_64"
BR2_PACKAGE_PYTHON3=y
BR2_TARGET_ROOTFS_CPIO=y
BR2_TARGET_ROOTFS_EXT2=y
BR2_TARGET_ROOTFS_EXT2_4=y
BR2_TARGET_SYSLINUX=y
BR2_TARGET_SYSLINUX_MBR=y
BR2_PACKAGE_HOST_GENIMAGE=y
```
